## src/kernel/mediatek/mt8168/4.14/drivers/misc/mediatek/sensors-1.0/accelerometer/lis2doc/Kconfig
```kconfig
config MTK_LIS2DOC
	bool "LIS2DOC for MediaTek package"
        default n
	help
	  It support different accelerometer sensor.
          If this option is set,
	  it will support
          LIS2DOC Accelerometer.
```

## src/kernel/mediatek/mt8168/4.14/drivers/misc/mediatek/video/common/pwm10/Kconfig
```kconfig
config SYNC_DISP_PWM_OFF
	bool "enable SYNC_DISP_PWM_OFF"
	default n
	help
	  define CONFIG_SYNC_DISP_PWM_OFF to set brightness to 0 before suspend
	  This feature only for disp pwm backlight
	  If unsure, set N.

config SKIP_BRIGHTNESS_AFTER_PWM_CLOCKOFF
	bool "enable SKIP_BRIGHTNESS_AFTER_PWM_CLOCKOFF"
	default n
	help
	  define SKIP_BRIGHTNESS_AFTER_PWM_CLOCKOFF to set skip set brightness after power_off
	  This feature only for disp pwm backlight
	  If unsure, set N.
```

## src/kernel/mediatek/mt8168/4.14/drivers/power/supply/mediatek/amzn_ld/Kconfig
```kconfig
config AMZN_LD
	tristate "AMZN_LD driver"
	default n
	help
	  Say Y here to enable support for type-c CC and SBU protection
```

## src/kernel/mediatek/mt8168/4.14/drivers/power/supply/mediatek/fusb301a/Kconfig
```kconfig
config FUSB301A
	tristate "fusb301 driver"
	depends on I2C
	default n
	help
	  Say Y here to enable support for type-c CC and SBU protection
	  IC FUSB301.
```

## src/kernel/mediatek/mt8168/4.14/drivers/power/supply/mediatek/wusb3801x/Kconfig
```kconfig
#
# USB Miscellaneous driver configuration
#
comment "USB Miscellaneous drivers"


config WUSB3801
	bool "IGC WUSB3801X Configuration Channel Controller for USB Type-C"
	depends on USB || I2C
	default n
	help
	  Enable this to support WUSB3801X CC Controller for USB Type C.
```

## src/kernel/mediatek/mt8168/4.14/drivers/staging/amazon/dspframework/Kconfig
```kconfig
menu "Amazon dsp framework driver"

config AMAZON_DSP_FRAMEWORK
	tristate "adf support"
	default n
	help
		support adf;

config AMAZON_DSP_FRAMEWORK_CHAR_LEN
	int "dsp char bit length"
	default 1
	help
		dsp char bit length;

endmenu
```

## src/kernel/mediatek/mt8168/4.14/sound/soc/codecs/dbmdx/Kconfig
```kconfig
#
# SoC audio configuration
#

config SND_SOC_DBMDX
	tristate "DSPG Voice Trigger/Enhancement Chip"
	default m
	help
		DSPG Voice Trigger/Enhancement Chip

config SND_SOC_DBMDX_USE_ANALOG_MICS
	bool "Microphones type is Analog"
	depends on SND_SOC_DBMDX
	default n
	help
		Set if Microphones type is Analog

config SND_SOC_DBMDX_SAR_ADC_SELECT_MIC2
	bool "Select SAR ADC MiC 2"
	depends on SND_SOC_DBMDX
	default n
	help
		Set if SAR ADC Mic2 should be used

config SND_SOC_DBMDX_SND_CAPTURE
	bool "DSPG Capture Device Support"
	depends on SND_SOC_DBMDX
	default n
	help
		Register DBMDX SOC as a separate sound card.
		.
		y - Register DBMDX SOC as separate sound card
		n - Do not register DBMDX SOC as separate sound card

config SND_SOC_DBMDX_ALEXA_WWE_SUPPORT
	bool "Wake Word Detection Engine Is Alexa"
	depends on SND_SOC_DBMDX
	default n
	help
		Wake Word Detection Engine Is Alexa

config SND_SOC_DBMDX_GENERAL_WWE_SUPPORT
	bool "Wake Word Detection Engine Is General"
	depends on SND_SOC_DBMDX
	default n
	help
		Wake Word Detection Engine Is General

config AMAZON_DSP_FRAMEWORK
	tristate "adf support"
	default n
	help
		support adf;
```
